## app/main/Kconfig.projbuild
```kconfig
# Copyright © 2026 Thor H. Linløkken <thj@thj.no>
# License: CERN-OHL-S v2

menu "Noaidi test"

config NOAIDI_STRESS_TEST
    bool "Enable synthetic MIDI stress-test injector"
    default n
    help
        Spawns a task at boot that floods the event bus with CC sweeps
        (voice mode / volume / mix) and note on/off for ~60 s, to
        reproduce load-related crashes deterministically
        without an external MIDI source. Leave OFF for normal firmware.

endmenu
```
